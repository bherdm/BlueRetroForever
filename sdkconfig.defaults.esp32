## sdkconfig.defaults.esp32
```kconfig
CONFIG_BTDM_CTRL_MODE_BTDM=y
CONFIG_BTDM_CTRL_BLE_MAX_CONN=7
CONFIG_BTDM_CTRL_BR_EDR_MAX_ACL_CONN=7
CONFIG_BTDM_CTRL_BR_EDR_SCO_DATA_PATH_HCI=y
CONFIG_BTDM_CTRL_AUTO_LATENCY=y
CONFIG_BTDM_CTRL_HLI=n
CONFIG_BTDM_CTRL_MODEM_SLEEP=n
CONFIG_ESP32_REV_MIN_1=y
# Can't use SRAM1 for IRAM as it conflict with un-updatable bootloaders in the wild :@ .
# CONFIG_ESP_SYSTEM_ESP32_SRAM1_REGION_AS_IRAM=y
```

## sdkconfig.defaults.esp32s2
```kconfig
CONFIG_SECURE_BOOT=y
CONFIG_SECURE_BOOT_SIGNING_KEY="keys/secure_boot_signing_key.pem"
CONFIG_SECURE_FLASH_ENC_ENABLED=y
CONFIG_SECURE_FLASH_ENCRYPTION_MODE_RELEASE=y
CONFIG_SECURE_DISABLE_ROM_DL_MODE=y
CONFIG_PARTITION_TABLE_CUSTOM_FILENAME="partitions_s2.csv"
CONFIG_PARTITION_TABLE_OFFSET=0xF000
# CONFIG_NVS_ENCRYPTION is not set
```
